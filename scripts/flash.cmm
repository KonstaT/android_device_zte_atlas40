;; Copyright 2007, Google Inc.
;; flash driver script
;;

local &arg_ptn
local &arg_img
local &arg_extra
local &arg_size

local &result
global &img_size
local &status

ENTRY &arg_ptn &arg_img &arg_extra

do setup.cmm

if ("&arg_extra"!="again")
(
  area
  area.clear
)

if ("&arg_ptn"=="")
(
  print "USAGE: do flash <partition> <image>"
  enddo
)

if ("&arg_extra"!="again")
(
  RESET
  SYStem.RESet
  WINCLEAR
  SYSTEM.CPU CortexA5
  SYStem.CONFIG MEMORYACCESSPORT   0
  SYStem.CONFIG DEBUGACCESSPORT    0
  SYStem.CONFIG COREBASE           0xC0510000
  SYStem.CONFIG ETMBASE            0xC0520000
  SYStem.CONFIG TPIUBASE           0xC0530000
  System.Option EnReset    OFF
  System.Option TRST       OFF
  SYStem.Option DIAG       ON
  ETM.DIAG                 ON
  ETM.OFF
  PRINT VERSION.BUILD()
  SYSTEM.JtagClock 5Mhz
  SYSTEM.UP

  if state.run()
  (
    break
  )
  data.load.elf "&(NANDWRITE)"
)

if ("&arg_img"=="MEMORY")
(
  &img_size=&arg_extra
)
else
(
  if ("&arg_img"!="")
  (
    if y.exist("\\flashimg")
      symbol.delete \\flashimg
    data.load.binary &arg_img &SYSTEM_HDR_ADDR /name flashimg /noclear
    &img_size=os.file.size(&arg_img)
  )
  else
  (
    &img_size=0
  )
)

&arg_ptn="flash:&arg_ptn"

if ("&arg_extra"!="dont_flash")
(
  do debug &arg_ptn &SYSTEM_HDR_ADDR &img_size
)

entry &result
enddo &result
